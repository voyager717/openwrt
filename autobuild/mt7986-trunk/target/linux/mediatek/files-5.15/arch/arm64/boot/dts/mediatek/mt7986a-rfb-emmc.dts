/* SPDX-License-Identifier: (GPL-2.0-only OR MIT) */

/dts-v1/;
/plugin/;

/ {
        compatible = "mediatek,mt7986a-emmc-rfb";

        fragment@0 {
		target-path = "/soc/mmc@11230000";
                __overlay__ {
			status = "okay";
		};
        };
};
