## build_dir/target-aarch64_cortex-a53_musl/linux-mediatek_mt7981/mapfilter/Kconfig
```kconfig
config MAP_FILTER_SUPPORT
	tristate "MAP netfilter support."
	default n
	---help---
		if you want to 1905 daemon work, you must enable this option.
```
